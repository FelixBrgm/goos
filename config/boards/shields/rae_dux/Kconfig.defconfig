## config/boards/shields/rae_dux/Kconfig.defconfig
```kconfig
# Copyright (c) 2022 The ZMK Contributors
# SPDX-License-Identifier: MIT
CONFIG_ZMK_POINTING=y
if SHIELD_GOOS_LEFT

config ZMK_KEYBOARD_NAME
	default "goos"

config ZMK_SPLIT_BLE_ROLE_CENTRAL
	default y

endif

if SHIELD_GOOS_LEFT || SHIELD_GOOS_RIGHT

config ZMK_SPLIT
	default y

endif
```

## config/boards/shields/rae_dux/Kconfig.shield
```kconfig
# Copyright (c) 2022 The ZMK Contributors
# SPDX-License-Identifier: MIT

config SHIELD_GOOS_LEFT
	def_bool $(shields_list_contains,goos_left)

config SHIELD_GOOS_RIGHT
	def_bool $(shields_list_contains,goos_right)
```

## config/west.yml
```yaml
manifest:
  remotes:
    - name: zmkfirmware
      url-base: https://github.com/zmkfirmware
    - name: andrewjrae
      url-base: https://github.com/andrewjrae
  projects:
    - name: zmk
      remote: zmkfirmware
      revision: main
      import: app/west.yml
  self:
    path: config
```
